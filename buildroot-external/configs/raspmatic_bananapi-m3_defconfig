## buildroot-external/configs/raspmatic_bananapi-m3_defconfig
```kconfig
BR2_arm=y
BR2_cortex_a7=y
BR2_KERNEL_HEADERS_3_4=y
BR2_GCC_VERSION_5_X=y
BR2_SYSTEM_DHCP="eth0"
BR2_ROOTFS_POST_IMAGE_SCRIPT="support/scripts/genimage.sh"
BR2_ROOTFS_POST_SCRIPT_ARGS="-c $(BR2_EXTERNAL)/board/bananapi-m3/genimage.cfg $(BR2_EXTERNAL)/board/bananapi-m3/boot.cmd"
BR2_LINUX_KERNEL=y
BR2_LINUX_KERNEL_CUSTOM_TARBALL=y
BR2_LINUX_KERNEL_CUSTOM_TARBALL_LOCATION="https://github.com/BPI-SINOVOIP/BPI-M3-bsp/archive/3bf23887f30b65dd8d9f5ae5b2cb9233938ebbc7.tar.gz"
BR2_LINUX_KERNEL_PATCH="$(BR2_EXTERNAL)/board/bananapi-m3/kernel-patches"
BR2_LINUX_KERNEL_DEFCONFIG="sun8iw6p1smp_bpi"
BR2_TARGET_ROOTFS_EXT2=y
BR2_TARGET_ROOTFS_EXT2_4=y
BR2_TARGET_UBOOT=y
BR2_TARGET_UBOOT_BUILD_SYSTEM_KCONFIG=y
BR2_TARGET_UBOOT_CUSTOM_VERSION=y
BR2_TARGET_UBOOT_CUSTOM_VERSION_VALUE="2017.09"
BR2_TARGET_UBOOT_BOARD_DEFCONFIG="Sinovoip_BPI_M3"
BR2_TARGET_UBOOT_NEEDS_DTC=y
BR2_TARGET_UBOOT_SPL=y
BR2_TARGET_UBOOT_SPL_NAME="u-boot-sunxi-with-spl.bin"
BR2_TARGET_UBOOT_BOOT_SCRIPT=y
BR2_TARGET_UBOOT_BOOT_SCRIPT_SOURCE="$(BR2_EXTERNAL)/board/bananapi-m3/boot.cmd"
BR2_PACKAGE_HOST_GENEXT2FS=y
BR2_PACKAGE_HOST_GENIMAGE=y
BR2_PACKAGE_HOST_UBOOT_TOOLS=y
```

## buildroot-external/configs/raspmatic_odroidc2_defconfig
```kconfig
BR2_aarch64=y
BR2_DL_DIR="$(TOPDIR)/../download"
BR2_KERNEL_MIRROR="https://www.kernel.org/pub"
BR2_GNU_MIRROR="http://ftp.gnu.org/pub/gnu"
BR2_OPTIMIZE_2=y
BR2_GLOBAL_PATCH_DIR="$(BR2_EXTERNAL)/patches"
BR2_TOOLCHAIN_BUILDROOT_GLIBC=y
BR2_KERNEL_HEADERS_VERSION=y
BR2_DEFAULT_KERNEL_VERSION="3.14.79"
BR2_PACKAGE_HOST_LINUX_HEADERS_CUSTOM_3_14=y
BR2_GCC_VERSION_4_9_X=y
BR2_TOOLCHAIN_BUILDROOT_CXX=y
BR2_TARGET_GENERIC_HOSTNAME="homematic-raspi"
BR2_TARGET_GENERIC_ISSUE="Welcome to RaspberryMatic"
BR2_TARGET_GENERIC_PASSWD_SHA512=y
BR2_ROOTFS_DEVICE_CREATION_DYNAMIC_EUDEV=y
BR2_TARGET_LOCALTIME="Europe/Berlin"
BR2_ROOTFS_OVERLAY="$(BR2_EXTERNAL)/overlay/base $(BR2_EXTERNAL)/overlay/WebUI $(BR2_EXTERNAL)/overlay/RFD"
BR2_ROOTFS_POST_IMAGE_SCRIPT="$(BR2_EXTERNAL)/board/odroidc2/post-image.sh"
BR2_LINUX_KERNEL=y
BR2_LINUX_KERNEL_CUSTOM_GIT=y
BR2_LINUX_KERNEL_CUSTOM_REPO_URL="https://github.com/hardkernel/linux.git"
BR2_LINUX_KERNEL_CUSTOM_REPO_VERSION="0bf410904ae95fcf1d5bc4b8760634c844801116"
BR2_LINUX_KERNEL_DEFCONFIG="odroidc2"
BR2_LINUX_KERNEL_DTS_SUPPORT=y
BR2_LINUX_KERNEL_INTREE_DTS_NAME="meson64_odroidc2"
BR2_PACKAGE_BUSYBOX_CONFIG="$(BR2_EXTERNAL)/Busybox.config"
BR2_PACKAGE_BUSYBOX_WATCHDOG=y
BR2_PACKAGE_E2FSPROGS=y
BR2_PACKAGE_E2FSPROGS_E4DEFRAG=y
BR2_PACKAGE_E2FSPROGS_RESIZE2FS=y
BR2_PACKAGE_NTFS_3G=y
BR2_PACKAGE_DEJAVU=y
BR2_PACKAGE_LIBERATION=y
BR2_PACKAGE_PSPLASH=y
BR2_PACKAGE_I2C_TOOLS=y
BR2_PACKAGE_ODROID_SCRIPTS=y
BR2_PACKAGE_PARTED=y
BR2_PACKAGE_RNG_TOOLS=y
BR2_PACKAGE_SMARTMONTOOLS=y
BR2_PACKAGE_USBMOUNT=y
BR2_PACKAGE_CA_CERTIFICATES=y
BR2_PACKAGE_LIBOPENSSL_BIN=y
BR2_PACKAGE_FONTCONFIG=y
BR2_PACKAGE_LIBUSB=y
BR2_PACKAGE_LIBUSB_COMPAT=y
BR2_PACKAGE_WIRINGPI=y
BR2_PACKAGE_LIBCURL=y
BR2_PACKAGE_CURL=y
BR2_PACKAGE_MSMTP=y
BR2_PACKAGE_BLUEZ5_UTILS=y
BR2_PACKAGE_BLUEZ5_UTILS_OBEX=y
BR2_PACKAGE_BLUEZ5_UTILS_CLIENT=y
BR2_PACKAGE_BLUEZ5_UTILS_DEPRECATED=y
BR2_PACKAGE_IFPLUGD=y
BR2_PACKAGE_IPTABLES=y
BR2_PACKAGE_IW=y
BR2_PACKAGE_LIGHTTPD=y
BR2_PACKAGE_LIGHTTPD_OPENSSL=y
BR2_PACKAGE_LIGHTTPD_ZLIB=y
BR2_PACKAGE_LIGHTTPD_PCRE=y
BR2_PACKAGE_NTP=y
BR2_PACKAGE_NTP_NTPDATE=y
BR2_PACKAGE_NTP_NTPQ=y
BR2_PACKAGE_NTP_NTPSNMPD=y
BR2_PACKAGE_OPENSSH=y
BR2_PACKAGE_OPENVPN=y
BR2_PACKAGE_RSYNC=y
BR2_PACKAGE_SOCAT=y
BR2_PACKAGE_WGET=y
BR2_PACKAGE_WPA_SUPPLICANT=y
BR2_PACKAGE_WPA_SUPPLICANT_AP_SUPPORT=y
BR2_PACKAGE_WPA_SUPPLICANT_EAP=y
BR2_PACKAGE_WPA_SUPPLICANT_HOTSPOT=y
BR2_PACKAGE_WPA_SUPPLICANT_DEBUG_SYSLOG=y
BR2_PACKAGE_WPA_SUPPLICANT_WPS=y
BR2_PACKAGE_WPA_SUPPLICANT_CLI=y
BR2_PACKAGE_WPA_SUPPLICANT_PASSPHRASE=y
BR2_PACKAGE_WPA_SUPPLICANT_DBUS_NEW=y
BR2_PACKAGE_WPA_SUPPLICANT_DBUS_INTROSPECTION=y
BR2_PACKAGE_XINETD=y
BR2_PACKAGE_LOGROTATE=y
BR2_PACKAGE_IRQBALANCE=y
BR2_PACKAGE_KMOD_TOOLS=y
BR2_PACKAGE_NUT=y
BR2_PACKAGE_TAR=y
BR2_TARGET_ROOTFS_EXT2=y
BR2_TARGET_ROOTFS_EXT2_4=y
BR2_TARGET_ROOTFS_EXT2_LABEL="rootfs"
BR2_TARGET_ROOTFS_EXT2_SIZE="512000"
BR2_TARGET_UBOOT=y
BR2_TARGET_UBOOT_BOARDNAME="odroidc2"
BR2_TARGET_UBOOT_CUSTOM_GIT=y
BR2_TARGET_UBOOT_CUSTOM_REPO_URL="https://github.com/hardkernel/u-boot.git"
BR2_TARGET_UBOOT_CUSTOM_REPO_VERSION="2e4380b16e671c2822343ad17aac318d4c6e539b"
BR2_PACKAGE_HOST_DOSFSTOOLS=y
BR2_PACKAGE_HOST_GENIMAGE=y
BR2_PACKAGE_HOST_MTOOLS=y
BR2_PACKAGE_OCCU=y
BR2_PACKAGE_OCCU_RF_PROTOCOL_HM_HMIP=y
BR2_PACKAGE_OCCU_WEBUI=y
BR2_PACKAGE_OCCU_WEBUI_REGAHSS_BETA=y
BR2_PACKAGE_OCCU_HMSERVER=y
BR2_PACKAGE_CLOUDMATIC=y
BR2_PACKAGE_HMLANGW=y
BR2_PACKAGE_EQ3_CHAR_LOOP=y
BR2_PACKAGE_RX8130_RTC=y
BR2_PACKAGE_SUSVD=y
BR2_PACKAGE_PICOD=y
BR2_PACKAGE_STROMPI2D=y
BR2_PACKAGE_DAEMONIZE=y
BR2_PACKAGE_SSDPD=y
BR2_PACKAGE_EQ3CONFIGD=y
BR2_PACKAGE_JAVA_AZUL=y
```
